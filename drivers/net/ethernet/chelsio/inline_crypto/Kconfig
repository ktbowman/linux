## drivers/net/ethernet/chelsio/inline_crypto/Kconfig
```kconfig
# SPDX-License-Identifier: GPL-2.0-only
#
# Chelsio inline crypto configuration
#

config CHELSIO_INLINE_CRYPTO
	bool "Chelsio Inline Crypto support"
	default y
	help
	  Enable support for inline crypto.
	  Allows enable/disable from list of inline crypto drivers.

if CHELSIO_INLINE_CRYPTO


endif # CHELSIO_INLINE_CRYPTO
```
